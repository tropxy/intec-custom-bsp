## build/conf/bblayers.conf
```bitbake
# POKY_BBLAYERS_CONF_VERSION is increased each time build/conf/bblayers.conf
# changes incompatibly
POKY_BBLAYERS_CONF_VERSION = "2"

BBPATH = "${TOPDIR}"
BBFILES ?= ""

BBLAYERS ?= " \
  /home/ubuntu/build_yocto/yocto_git/layers/poky/meta \
  /home/ubuntu/build_yocto/yocto_git/layers/poky/meta-poky \
  /home/ubuntu/build_yocto/yocto_git/layers/meta-freescale \
  /home/ubuntu/build_yocto/yocto_git/layers/meta-openembedded/meta-oe \
  /home/ubuntu/build_yocto/yocto_git/layers/meta-openembedded/meta-python \
  /home/ubuntu/build_yocto/yocto_git/layers/meta-openembedded/meta-networking \
  /home/ubuntu/build_yocto/yocto_git/layers/meta-openembedded/meta-filesystems \
  /home/ubuntu/build_yocto/yocto_git/layers/meta-openembedded/meta-multimedia \
  /home/ubuntu/build_yocto/yocto_git/layers/meta-rauc \
  /home/ubuntu/build_yocto/yocto_git/layers/meta-in-tech-sc \
  /home/ubuntu/build_yocto/yocto_git/layers/meta-in-tech-sc-distro \
  /home/ubuntu/build_yocto/yocto_git/layers/meta-virtualization \
  "
```

## source/meta-in-tech-sc/conf/machine/tarragon.conf
```bitbake
#@TYPE: Machine
#@NAME: in-tech Tarragon Platform
#@SOC: i.MX6ULL
#@DESCRIPTION: Machine configuration for in-tech Tarragon Boards
#@MAINTAINER: Michael Heimpold <michael.heimpold@in-tech.com>

MACHINEOVERRIDES =. "mx6:mx6ull:"

include conf/machine/include/imx-base.inc
include conf/machine/include/tune-cortexa7.inc

UBOOT_MACHINE = "tarragon_config"

KERNEL_DEVICETREE = "imx6ull-tarragon-master.dtb imx6ull-tarragon-slave.dtb imx6ull-tarragon-micro.dtb imx6ull-tarragon-slavext.dtb"

PREFERRED_PROVIDER_u-boot = "u-boot-imx"
PREFERRED_PROVIDER_virtual/bootloader = "u-boot-imx"
PREFERRED_PROVIDER_virtual/kernel = "linux-imx"

SERIAL_CONSOLES = "115200;ttymxc3"

MACHINE_FIRMWARE_remove = "firmware-imx-epdc"

# RAUC Configurations

RAUC_BUNDLE_SLOTS ?= "rootfs"

RAUC_BUNDLE_COMPATIBLE = "I2SE Tarragon"

RAUC_KEY_FILE = "/home/ubuntu/build_yocto/yocto_git/switch.key.pem"

RAUC_CERT_FILE = "/home/ubuntu/build_yocto/yocto_git/switch.cert.pem"

##   RAUC_BUNDLE_COMPATIBLE ?= "My Super Product"
##   RAUC_BUNDLE_VERSION ?= "v2015-06-07-1"
##
#   RAUC_BUNDLE_HOOKS[file] ?= "hook.sh"
##   RAUC_BUNDLE_HOOKS[hooks] ?= "install-check"
##
##   RAUC_BUNDLE_SLOTS ?= "rootfs kernel dtb bootloader"
##
##   RAUC_SLOT_rootfs ?= "core-image-minimal"
##   RAUC_SLOT_rootfs[fstype] = "ext4"
RAUC_SLOT_rootfs[hooks] ?= "post-install"
##
##   RAUC_SLOT_kernel ?= "linux-yocto"
##   RAUC_SLOT_kernel[type] ?= "kernel"
##
##   RAUC_SLOT_bootloader ?= "barebox"
##   RAUC_SLOT_bootloader[type] ?= "boot"
##   RAUC_SLOT_bootloader[file] ?= "barebox.img"
##
##   RAUC_SLOT_dtb ?= linux-yocto
##   RAUC_SLOT_dtb[type] ?= "file"
```
